## firmware/pager/main/Kconfig.projbuild
```kconfig
menu "Passport Pager"
    config PAGER_SIM_NO_BLE
        bool "Skip Bluetooth (simulator UI build only)"
        default n
        help
            PassportSim binds BLE only for ESP-IDF 5.5.3 images. This builds a variant that
            never starts the Bluetooth controller, so the screen and buttons can be tested there.
            Never enable it for firmware that goes on the device.
endmenu
```

## firmware/pager/sdkconfig.defaults
```kconfig
CONFIG_IDF_TARGET="esp32c3"
CONFIG_ESPTOOLPY_FLASHSIZE_8MB=y
CONFIG_ESPTOOLPY_HEADER_FLASHSIZE_UPDATE=n
CONFIG_PARTITION_TABLE_CUSTOM=y
CONFIG_PARTITION_TABLE_CUSTOM_FILENAME="partitions.csv"
CONFIG_ESP_CONSOLE_USB_SERIAL_JTAG=y
CONFIG_ESP_CONSOLE_SECONDARY_NONE=y
CONFIG_BOOTLOADER_APP_ROLLBACK_ENABLE=y
CONFIG_FREERTOS_HZ=1000
CONFIG_LV_COLOR_DEPTH_16=y
CONFIG_LV_FONT_MONTSERRAT_14=y
CONFIG_LV_FONT_MONTSERRAT_20=y
# 放映计时器与 hero 箭头/徽标用 48px
CONFIG_LV_FONT_MONTSERRAT_48=y
CONFIG_LV_MEM_SIZE_KILOBYTES=24

# BLE HID keyboard on NimBLE (esp-emu also emulates NimBLE)
CONFIG_BT_ENABLED=y
CONFIG_BT_NIMBLE_ENABLED=y
CONFIG_BT_NIMBLE_HID_SERVICE=y
# 需要 GATT 客户端去读对方的设备名；GATT 客户端在 NimBLE 里挂在 central 角色下
CONFIG_BT_NIMBLE_ROLE_CENTRAL=y
CONFIG_BT_NIMBLE_GATT_CLIENT=y
CONFIG_BT_NIMBLE_ROLE_OBSERVER=n
CONFIG_BT_NIMBLE_ROLE_PERIPHERAL=y
CONFIG_BT_NIMBLE_ROLE_BROADCASTER=y
CONFIG_BT_NIMBLE_MAX_CONNECTIONS=1
CONFIG_BT_NIMBLE_MAX_BONDS=4
CONFIG_BT_NIMBLE_NVS_PERSIST=y
CONFIG_BT_NIMBLE_SM_SC=y
CONFIG_BT_NIMBLE_SVC_GAP_DEVICE_NAME="Passport Pager"

# 中文用 assets/fonts 里生成的子集字体（tools/gen_fonts.sh），Montserrat 16 只作兜底
CONFIG_LV_FONT_MONTSERRAT_16=y
CONFIG_LV_TXT_ENC_UTF8=y
CONFIG_LV_USE_FONT_PLACEHOLDER=y
CONFIG_LV_DEF_REFR_PERIOD=20
```

## firmware/passport/main/sdkconfig.defaults
```kconfig
# 翻页器页：BLE HID 键盘（NimBLE），与 Wi-Fi 共存
CONFIG_BT_ENABLED=y
CONFIG_BT_NIMBLE_ENABLED=y
CONFIG_BT_NIMBLE_HID_SERVICE=y
CONFIG_BT_NIMBLE_ROLE_CENTRAL=y
CONFIG_BT_NIMBLE_GATT_CLIENT=y
CONFIG_BT_NIMBLE_ROLE_OBSERVER=n
CONFIG_BT_NIMBLE_ROLE_PERIPHERAL=y
CONFIG_BT_NIMBLE_ROLE_BROADCASTER=y
CONFIG_BT_NIMBLE_MAX_CONNECTIONS=1
CONFIG_BT_NIMBLE_MAX_BONDS=4
CONFIG_BT_NIMBLE_NVS_PERSIST=y
CONFIG_BT_NIMBLE_SM_SC=y
CONFIG_SW_COEXIST_ENABLE=y
CONFIG_ESP_COEX_SW_COEXIST_ENABLE=y

# One HID report map (keyboard and media reports).
CONFIG_BT_NIMBLE_SVC_HID_MAX_INSTANCES=1

CONFIG_BT_NIMBLE_MSYS_1_BLOCK_COUNT=6

CONFIG_BT_NIMBLE_MSYS_2_BLOCK_COUNT=8




CONFIG_BT_NIMBLE_ATT_PREFERRED_MTU=64

CONFIG_BT_CTRL_BLE_MAX_ACT=2

CONFIG_BT_NIMBLE_TRANSPORT_ACL_FROM_LL_COUNT=6

CONFIG_BT_NIMBLE_TRANSPORT_EVT_COUNT=8

CONFIG_BT_NIMBLE_TRANSPORT_EVT_DISCARD_COUNT=4
```
